## config/boards/shields/quadra/Kconfig.defconfig
```kconfig
if SHIELD_QUADRA_LEFT || SHIELD_QUADRA_RIGHT

config ZMK_KEYBOARD_NAME
    default "Quadra"
    
config ZMK_SPLIT
    default y

config ZMK_SPLIT_ROLE_CENTRAL
    default y
endif
```

## config/boards/shields/quadra/Kconfig.shield
```kconfig
config SHIELD_QUADRA_LEFT
    def_bool $(shields_list_contains,quadra_left)

config SHIELD_QUADRA_RIGHT
    def_bool $(shields_list_contains,quadra_right)
```
